// ---------------------------------------------------------------------------
// Rally CAN Gauge - gauge frame rendering implementation
// ---------------------------------------------------------------------------
// Layout of this file:
//   1. fonts + the theme (semantic colors, resolved once per frame)
//   2. value -> color: mapping alarm verdicts onto readouts
//   3. formatting + validity helpers
//   4. drawing primitives ported from the PC prototype (icons, bars, lambda)
//   5. the three gauge layouts
//   6. the MODE_DEBUG dense layout
//
// THE DESIGN, IN THREE RULES:
//
// (1) Stateless "compose then show", exactly like the LED strip: every call
//     rebuilds the whole frame from g_data. No element remembers what it
//     showed last tick, so there is no stale-pixel state to get wrong. This
//     costs CPU (~a millisecond per frame) but costs almost NO SPI traffic:
//     the display driver diffs the finished frame against what the glass
//     already shows and uploads only the pixels that changed. Redrawing
//     everything is not the same as uploading everything - that split is
//     what makes the whole architecture simple AND fast.
//
// (2) Colors are SEMANTIC, resolved through a per-frame Theme. Draw code
//     never says "blue"; it says t.info ("cold / informational"), and the
//     theme decides what that means: dodger blue by day, amber at night
//     (per the plan, night mode replaces every blue element - blue is the
//     worst color for dark-adapted eyes). One resolve point means night
//     mode can never miss an element.
//
// (3) A readout's color comes from ALARM VERDICTS, never from re-testing
//     values: each readout lists which alarms judge it, in catalog order
//     (= priority order), and wears the color of the first active one -
//     green when none are. Thresholds, hysteresis and persistence all
//     stay in alarms.cpp; if the display disagreed with the alarm system
//     about when "hot" starts, the driver would learn to distrust both.
//
// A dead data source draws as "--" in the dim divider color: a gauge that
// shows a plausible-looking 0 psi teaches panic, and one that freezes a
// stale 56 psi teaches complacency. Absent data must LOOK absent. The
// matching NO CAN / BATT CAN yellow alarm appears in the banner on its own.
// ---------------------------------------------------------------------------

#include <Arduino.h>
#include <tgx.h>

#include "gauge_render.h"
#include "config.h"
#include "vehicle_data.h"
#include "alarms.h"

// The custom Iosevka faces, generated by tgx's font tool at the exact pixel
// sizes the layouts use (no runtime scaling - each size is its own bitmap
// set). Monospaced on purpose: every digit occupies the same cell, so a
// value changing 199 -> 200 dirties only the glyphs' own pixels and the
// differential upload stays tiny. A proportional font would shift the whole
// string sideways and dirty everything. PROGMEM keeps all ~145 KB in flash
// (the Teensy 4 memory-maps flash through the cache - glyph blits read it
// like slightly-slower RAM, costing zero precious data RAM).
#include "fonts/IosevkaCustom_Regular.h"   // 30 px - labels, clock, debug
#include "fonts/IosevkaCustom_Heavy.h"     // 30 px - the warning banner
#include "fonts/IosevkaCustom_Extended.h"  // 55 px + 114 px - the values

static const ILI9341_t3_font_t& FONT_LABEL    = IosevkaCustom_Regular_AA4_30;
static const ILI9341_t3_font_t& FONT_BANNER   = IosevkaCustom_Heavy_AA4_30;
static const ILI9341_t3_font_t& FONT_VALUE_SM = IosevkaCustom_Extended_AA4_55;
static const ILI9341_t3_font_t& FONT_VALUE_LG = IosevkaCustom_Extended_AA4_114;

// --- 1. the theme -----------------------------------------------------------------

// Pack a config.h 0xRRGGBB color into the display's native RGB565 (5 bits
// red, 6 green, 5 blue - 16 bits total, which is why the framebuffer is
// uint16_t). The shifts just keep each channel's top bits.
static inline tgx::RGB565 pack565(uint32_t rgb)
    {
    return tgx::RGB565((int)((rgb >> 19) & 0x1F),
                       (int)((rgb >> 10) & 0x3F),
                       (int)((rgb >>  3) & 0x1F));
    }

// Every color a frame may use, resolved for THIS frame. Fields are semantic
// roles, not color names - "info" is the whole night-mode feature.
struct Theme
    {
    tgx::RGB565 bg;           // panel background
    tgx::RGB565 divider;      // separators, off segments, dead-value "--"
    tgx::RGB565 green;        // nominal values + labels
    tgx::RGB565 yellow;       // warning-state values
    tgx::RGB565 red;          // critical-state values
    tgx::RGB565 info;         // cold/informational: blue by day, amber at night
    tgx::RGB565 white;        // text on blue/red banner fills
    tgx::RGB565 darkText;     // text on yellow/green banner fills
    tgx::RGB565 brightsOff;   // the brights icon's dim "off" ghost
    tgx::RGB565 bannerYellow; // banner fill for yellow alarms
    tgx::RGB565 bannerRed;    // banner fill for red alarms
    tgx::RGB565 bannerInfoFg; // text on an info-colored banner: white on
                              // day-blue, dark on night-amber (contrast)
    };

static Theme buildTheme()
    {
    const bool night = g_data.mode.night;

    Theme t;
    t.bg           = pack565(COL_SCREEN_BG);
    t.divider      = pack565(COL_SCREEN_DIVIDER);
    t.green        = pack565(COL_SCREEN_GREEN);
    t.yellow       = pack565(COL_SCREEN_YELLOW);
    t.red          = pack565(COL_SCREEN_RED);
    t.info         = pack565(night ? COL_INFO_NIGHT : COL_INFO_DAY);
    t.white        = pack565(COL_SCREEN_WHITE);
    t.darkText     = pack565(COL_SCREEN_DARKTXT);
    t.brightsOff   = pack565(night ? COL_BRIGHTS_OFF_NIGHT : COL_BRIGHTS_OFF_DAY);
    t.bannerYellow = pack565(COL_BANNER_YELLOW);
    t.bannerRed    = pack565(COL_BANNER_RED);
    t.bannerInfoFg = night ? t.darkText : t.white;
    return t;
    }

// --- 2. value -> color from alarm verdicts ------------------------------------------

static tgx::RGB565 alarmTint(const Theme& t, AlarmColor c)
    {
    switch (c)
        {
        case ALARM_RED:    return t.red;
        case ALARM_YELLOW: return t.yellow;
        case ALARM_BLUE:   return t.info;
        default:           return t.green; // ALARM_GREEN (cranking)
        }
    }

// Each readout's judges, listed in AlarmId order. The enum is ordered by
// priority, so "first active entry" IS "most severe verdict" - the same
// zero-cost arbitration trick the alarm system itself uses.
static const uint8_t k_oilTempAlarms[]  = { ALARM_OIL_HOT_CRIT, ALARM_OIL_HOT_WARN, ALARM_OIL_COLD };
static const uint8_t k_oilPressAlarms[] = { ALARM_OIL_LOW_CRIT, ALARM_OIL_LOW_WARN, ALARM_OIL_HIGH_WARN };
static const uint8_t k_cltAlarms[]      = { ALARM_CLT_HOT_CRIT, ALARM_CLT_HOT_WARN, ALARM_CLT_COLD };
static const uint8_t k_voltAlarms[]     = { ALARM_VOLT_LOW_CRIT, ALARM_VOLT_LOW_WARN, ALARM_VOLT_HIGH_WARN };
static const uint8_t k_afrAlarms[]      = { ALARM_AFR_LEAN_CRIT, ALARM_AFR_LEAN_WARN, ALARM_AFR_RICH };
static const uint8_t k_fuelAlarms[]     = { ALARM_NO_GAS, ALARM_FUEL_LOW };

static tgx::RGB565 valueColor(const Theme& t, const uint8_t* ids, uint8_t n)
    {
    for (uint8_t i = 0; i < n; i++)
        if (g_data.alarms.active[ids[i]])
            return alarmTint(t, alarmColor(ids[i]));
    return t.green;
    }

// sizeof-based wrapper so call sites can't pass the wrong length
#define VALUE_COLOR(theme, list) valueColor(theme, list, sizeof(list) / sizeof((list)[0]))

// --- 3. formatting + validity helpers ----------------------------------------------

// Format v into buf, or return "--" when the source is stale/invalid.
static const char* fmtValue(char* buf, size_t n, float v, uint8_t decimals, bool valid)
    {
    if (!valid) return "--";
    snprintf(buf, n, "%.*f", decimals, v);
    return buf;
    }

// Freshness gates for DISPLAY, mirroring the gates alarms.cpp uses for
// judging: same source frames, same window, so a value and its alarm can
// never disagree about whether the data is real.
static bool oilFresh()  { return g_data.ecuFrameFresh(ECU_F_SENSORS2); }
static bool cltFresh()  { return g_data.ecuFrameFresh(ECU_F_SENSORS1); }
static bool voltFresh() { return g_data.ecuFrameFresh(ECU_F_SENSORS2); }

// Lambda additionally needs a real reading: rusEFI broadcasts 0 while the
// wideband warms up (or has failed), and "0.00" on the gauge would look
// like a catastrophically rich engine.
static bool lambdaFresh()
    {
    return g_data.ecuFrameFresh(ECU_F_LAMBDA) && g_data.ecu.lambda >= LAMBDA_SENSOR_MIN;
    }

// Square-wave flash phase from the shared millis() clock - same convention
// as led_tach.cpp: wall time, not a counter, so flashing elements never
// drift against each other. (They don't share a RATE: the banner flashes at
// 1 Hz, the strip's red at ~2 Hz - see the *_FLASH_HALF_MS constants.)
static bool flashOn(uint32_t halfPeriodMs)
    {
    return (millis() / halfPeriodMs) & 1;
    }

// --- 4. drawing primitives (ported from the bench-tested PC prototype) --------------
// Geometry is verbatim from ../Graphics/GaugeClusterPrototype.h - only the
// hardcoded colors were replaced by theme roles. If a shape looks odd on
// the real glass, fix it in the prototype first, re-render the PNGs, then
// copy the change here: the prototype is the layout's source of truth.

// A thick anti-aliased line built from two triangles (tgx has no native
// thick-line primitive; two AA triangles rasterize just as fast).
static void drawThickLineAA(tgx::Image<tgx::RGB565>& im, float x0, float y0,
                            float x1, float y1, float thickness, tgx::RGB565 color)
    {
    const float dx = x1 - x0;
    const float dy = y1 - y0;
    const float len = sqrtf(dx * dx + dy * dy);
    if (len < 0.001f) return;
    const float nx = -dy / len * (thickness * 0.5f);
    const float ny =  dx / len * (thickness * 0.5f);
    const tgx::fVec2 p0(x0 + nx, y0 + ny);
    const tgx::fVec2 p1(x0 - nx, y0 - ny);
    const tgx::fVec2 p2(x1 - nx, y1 - ny);
    const tgx::fVec2 p3(x1 + nx, y1 + ny);
    im.fillTriangleAA(p0, p1, p2, color);
    im.fillTriangleAA(p0, p2, p3, color);
    }

// Vector lambda symbol - drawn, not a font glyph (the Iosevka export has no
// lambda), sized to sit on the 30 px label line.
static void drawLambdaSymbol(tgx::Image<tgx::RGB565>& im, int cx, int cy, tgx::RGB565 color)
    {
    drawThickLineAA(im, cx - 8, cy - 12, cx + 9, cy + 12, 3.5f, color); // main stem
    drawThickLineAA(im, cx + 1, cy -  2, cx - 9, cy + 12, 3.5f, color); // left leg
    }

// 20-segment fuel bar, 5% per segment. Lit segments wear the fuel verdict
// color; unlit ones the divider color, so the bar reads at a glance even
// with no numbers.
static void drawFuelBar(tgx::Image<tgx::RGB565>& im, int minX, int minY,
                        int maxX, int maxY, float fuelPct, tgx::RGB565 litColor,
                        const Theme& t)
    {
    (void)maxX; // geometry is fixed by segment count/width; param kept for clarity
    const int numSegments = 20;
    const int segW = 6;
    const int segGap = 2; // (6+2) * 20 = 160 px, exactly minX..minX+160

    for (int i = 0; i < numSegments; i++)
        {
        const int sx0 = minX + i * (segW + segGap);
        const float segThresh = (i + 1) * 5.0f;
        const bool lit = (segThresh <= fuelPct + 0.1f);
        im.fillRect(tgx::iBox2(sx0, sx0 + segW, minY, maxY),
                    lit ? litColor : t.divider);
        }
    }

// The fuel filler arrow (the "Moylan arrow"): the small arrow every OEM
// fuel gauge tucks beside the pump symbol so you never pull up on the wrong
// side of the pump. Points toward the filler flap - right for the E30's
// passenger-side flap (config.h, FUEL_FILLER_ARROW_RIGHT). cx/cy is the
// arrow's center; 18 px long, 14 px tall, sized against the 30 px label.
static void drawFuelFillerArrow(tgx::Image<tgx::RGB565>& im, int cx, int cy,
                                bool right, tgx::RGB565 col)
    {
    if (right)
        {
        im.fillRect(tgx::iBox2(cx - 9, cx + 1, cy - 2, cy + 2), col);           // shaft
        im.fillTriangleAA(tgx::fVec2(cx + 1, cy - 7), tgx::fVec2(cx + 1, cy + 7),
                          tgx::fVec2(cx + 9, cy), col);                         // head
        }
    else
        {
        im.fillRect(tgx::iBox2(cx - 1, cx + 9, cy - 2, cy + 2), col);
        im.fillTriangleAA(tgx::fVec2(cx - 1, cy - 7), tgx::fVec2(cx - 1, cy + 7),
                          tgx::fVec2(cx - 9, cy), col);
        }
    }

// The four indicator icons. Turn arrows + low beams show solid green when
// on (they are status, not warnings); brights show the info color - the one
// icon that goes amber at night, because a lit blue lamp symbol is exactly
// the glare night mode exists to remove.

static void drawLeftTurnIcon(tgx::Image<tgx::RGB565>& im, int cx, int cy,
                             bool on, const Theme& t)
    {
    const tgx::RGB565 col = on ? t.green : t.divider;
    im.fillTriangleAA(tgx::fVec2(cx - 15, cy), tgx::fVec2(cx - 1, cy - 13),
                      tgx::fVec2(cx - 1, cy + 13), col);
    im.fillRect(tgx::iBox2(cx - 1, cx + 15, cy - 5, cy + 5), col);
    }

static void drawRightTurnIcon(tgx::Image<tgx::RGB565>& im, int cx, int cy,
                              bool on, const Theme& t)
    {
    const tgx::RGB565 col = on ? t.green : t.divider;
    im.fillTriangleAA(tgx::fVec2(cx + 15, cy), tgx::fVec2(cx + 1, cy - 13),
                      tgx::fVec2(cx + 1, cy + 13), col);
    im.fillRect(tgx::iBox2(cx - 15, cx + 1, cy - 5, cy + 5), col);
    }

// D-shaped lamp housing shared by both beam icons
static void drawLampHousing(tgx::Image<tgx::RGB565>& im, int cx, int cy, tgx::RGB565 col)
    {
    im.fillRoundRect(tgx::iBox2(cx + 5, cx + 15, cy - 13, cy + 13), 5, col);
    im.fillRect(tgx::iBox2(cx + 2, cx + 10, cy - 11, cy + 11), col);
    im.fillRoundRect(tgx::iBox2(cx + 1, cx + 6, cy - 8, cy + 8), 3, col);
    }

static void drawHeadlightsIcon(tgx::Image<tgx::RGB565>& im, int cx, int cy,
                               bool on, const Theme& t)
    {
    const tgx::RGB565 col = on ? t.green : t.divider;
    drawLampHousing(im, cx, cy, col);
    // 5 down-slanted rays = low beam
    drawThickLineAA(im, cx - 2, cy - 11.0f, cx - 15, cy -  6.0f, 2.3f, col);
    drawThickLineAA(im, cx - 2, cy -  5.5f, cx - 15, cy -  0.5f, 2.3f, col);
    drawThickLineAA(im, cx - 2, cy,         cx - 15, cy +  5.0f, 2.3f, col);
    drawThickLineAA(im, cx - 2, cy +  5.5f, cx - 15, cy + 10.5f, 2.3f, col);
    drawThickLineAA(im, cx - 2, cy + 11.0f, cx - 15, cy + 16.0f, 2.3f, col);
    }

static void drawBrightsIcon(tgx::Image<tgx::RGB565>& im, int cx, int cy,
                            bool on, const Theme& t)
    {
    const tgx::RGB565 col = on ? t.info : t.brightsOff;
    drawLampHousing(im, cx, cy, col);
    // 5 straight rays = high beam
    drawThickLineAA(im, cx - 2, cy - 11.0f, cx - 15, cy - 11.0f, 2.3f, col);
    drawThickLineAA(im, cx - 2, cy -  5.5f, cx - 15, cy -  5.5f, 2.3f, col);
    drawThickLineAA(im, cx - 2, cy,         cx - 15, cy,         2.3f, col);
    drawThickLineAA(im, cx - 2, cy +  5.5f, cx - 15, cy +  5.5f, 2.3f, col);
    drawThickLineAA(im, cx - 2, cy + 11.0f, cx - 15, cy + 11.0f, 2.3f, col);
    }

// Frame skeleton shared by all three layouts: background + the double
// vertical divider that splits the big value (left 256 px) from the
// secondary stack (right 172 px).
static void drawFrameBase(tgx::Image<tgx::RGB565>& im, const Theme& t)
    {
    im.fillScreen(t.bg);
    im.drawFastVLine({256, 8}, SCREEN_LY - 16, t.divider);
    im.drawFastVLine({257, 8}, SCREEN_LY - 16, t.divider);
    }

// --- the warning banner --------------------------------------------------------------
// Bottom-right box of the OIL/VOLTS screen. Shows the single top-priority
// active alarm (g_data.alarms.top - arbitration already done), blank when
// nominal. Fill color follows the alarm's catalog color; on a RED alarm the
// whole box flashes at 1 Hz to catch peripheral vision - unless silent mode
// says "I know, stop telling me", which turns flashing off everywhere
// (banner solid, voice muted, LED strip calm) but never hides the message.

static void drawBanner(tgx::Image<tgx::RGB565>& im, const Theme& t)
    {
    const uint8_t top = g_data.alarms.top;
    if (top == ALARM_NONE) return; // nominal: the box simply isn't there

    const AlarmColor c = alarmColor(top);

    if (c == ALARM_RED && !g_data.mode.silent && !flashOn(SCREEN_RED_FLASH_HALF_MS))
        return; // flash off-phase: whole box blinks out, maximum contrast

    tgx::RGB565 fill, fg;
    switch (c)
        {
        case ALARM_RED:    fill = t.bannerRed;    fg = t.white;        break;
        case ALARM_YELLOW: fill = t.bannerYellow; fg = t.darkText;     break;
        case ALARM_BLUE:   fill = t.info;         fg = t.bannerInfoFg; break;
        default:           fill = t.green;        fg = t.darkText;     break; // CRANKING
        }

    // Catalog names are space-padded to 8 chars ("OIL LOW "); trim the tail
    // so the centered text is actually centered.
    char name[9];
    strncpy(name, alarmName(top), 8);
    name[8] = '\0';
    for (int k = 7; k >= 0 && name[k] == ' '; k--) name[k] = '\0';

    im.fillRoundRect(tgx::iBox2(262, SCREEN_LX - 6, 103, SCREEN_LY - 6), 5, fill);
    im.drawTextEx(name, {342, 120}, FONT_BANNER, tgx::Anchor::CENTER,
                  false, false, fg);
    }

// --- 5. the three gauge layouts -----------------------------------------------------

// OIL TEMP (big) + VOLTS + the warning banner
static void renderOilVolts(tgx::Image<tgx::RGB565>& im, const Theme& t)
    {
    drawFrameBase(im, t);
    char buf[16];

    // "\xB0" is the degree sign (last glyph in the Iosevka export); split
    // from "C" so the compiler doesn't read the hex escape as \xB0C.
    im.drawTextEx("OIL TEMP \xB0" "C", {128, 2}, FONT_LABEL,
                  tgx::Anchor::CENTERTOP, false, false, t.green);

    const bool oilOk = oilFresh();
    im.drawTextEx(fmtValue(buf, sizeof(buf), g_data.ecu.oilTempC, 0, oilOk),
                  {251, SCREEN_LY - 2}, FONT_VALUE_LG, tgx::Anchor::BOTTOMRIGHT,
                  false, false, oilOk ? VALUE_COLOR(t, k_oilTempAlarms) : t.divider);

    im.drawTextEx("VOLTS", {342, 2}, FONT_LABEL,
                  tgx::Anchor::CENTERTOP, false, false, t.green);

    const bool voltOk = voltFresh();
    im.drawTextEx(fmtValue(buf, sizeof(buf), g_data.ecu.battVolts, 1, voltOk),
                  {SCREEN_LX - 6, 40}, FONT_VALUE_SM, tgx::Anchor::TOPRIGHT,
                  false, false, voltOk ? VALUE_COLOR(t, k_voltAlarms) : t.divider);

    im.drawFastHLine({262, 98}, SCREEN_LX - 270, t.divider);
    drawBanner(im, t);
    }

// CLT TEMP (big) + calculated fuel % + sender fuel bar + clock.
// The two fuel estimates split per the plan: the NUMBER is the calculated
// (injector-integration) value - smooth, precise, what you strategize on;
// the BAR is the slosh-filtered sender - the physical measurement, the one
// that can't drift. When they disagree, that disagreement is visible right
// here, stacked 40 px apart.
static void renderCltFuel(tgx::Image<tgx::RGB565>& im, const Theme& t)
    {
    drawFrameBase(im, t);
    char buf[16];

    im.drawTextEx("CLT TEMP \xB0" "C", {128, 2}, FONT_LABEL,
                  tgx::Anchor::CENTERTOP, false, false, t.green);

    const bool cltOk = cltFresh();
    im.drawTextEx(fmtValue(buf, sizeof(buf), g_data.ecu.cltC, 0, cltOk),
                  {251, SCREEN_LY - 2}, FONT_VALUE_LG, tgx::Anchor::BOTTOMRIGHT,
                  false, false, cltOk ? VALUE_COLOR(t, k_cltAlarms) : t.divider);

    im.drawTextEx("FUEL", {342, 2}, FONT_LABEL,
                  tgx::Anchor::CENTERTOP, false, false, t.green);
    // The filler-side arrow rides beside the label in label green: it is a
    // fixed fact about the car, not a state, so it never changes color.
    drawFuelFillerArrow(im, FUEL_FILLER_ARROW_RIGHT ? 392 : 292, 15,
                        FUEL_FILLER_ARROW_RIGHT, t.green);

    const tgx::RGB565 fuelCol = VALUE_COLOR(t, k_fuelAlarms);

    const bool calcOk = g_data.fuel.calcValid;
    if (calcOk) snprintf(buf, sizeof(buf), "%.0f%%", g_data.fuel.calcPct);
    im.drawTextEx(calcOk ? buf : "--", {SCREEN_LX - 6, 40}, FONT_VALUE_SM,
                  tgx::Anchor::TOPRIGHT, false, false,
                  calcOk ? fuelCol : t.divider);

    // The bar always draws the sender level: on wiring faults inputs.cpp
    // freezes the last good value (better than a bar snapping to empty at
    // speed) and the banner carries the actual complaint.
    drawFuelBar(im, 262, 93, SCREEN_LX - 6, 101, g_data.fuel.levelPct, fuelCol, t);

    const BoardData& b = g_data.board;
    if (b.clockValid) snprintf(buf, sizeof(buf), "%02u:%02u:%02u", b.hh, b.mm, b.ss);
    im.drawTextEx(b.clockValid ? buf : "--:--:--", {342, 120}, FONT_LABEL,
                  tgx::Anchor::CENTER, false, false, t.green);
    }

// OIL PSI (big) + lambda + the four indicator icons
static void renderPsiLambda(tgx::Image<tgx::RGB565>& im, const Theme& t)
    {
    drawFrameBase(im, t);
    char buf[16];

    im.drawTextEx("OIL PSI", {128, 2}, FONT_LABEL,
                  tgx::Anchor::CENTERTOP, false, false, t.green);

    const bool oilOk = oilFresh();
    im.drawTextEx(fmtValue(buf, sizeof(buf), g_data.ecu.oilPressPsi, 0, oilOk),
                  {128, SCREEN_LY - 2}, FONT_VALUE_LG, tgx::Anchor::CENTERBOTTOM,
                  false, false, oilOk ? VALUE_COLOR(t, k_oilPressAlarms) : t.divider);

    drawLambdaSymbol(im, 342, 18, t.green); // the label of the right column

    // rusEFI broadcasts lambda directly - the fuel-agnostic form the alarms
    // are defined on, so it is also what we display.
    const bool lamOk = lambdaFresh();
    im.drawTextEx(fmtValue(buf, sizeof(buf), g_data.ecu.lambda, 2, lamOk),
                  {SCREEN_LX - 6, 40}, FONT_VALUE_SM, tgx::Anchor::TOPRIGHT,
                  false, false, lamOk ? VALUE_COLOR(t, k_afrAlarms) : t.divider);

    im.drawFastHLine({262, 98}, SCREEN_LX - 270, t.divider);

    // Indicator row. Blinker inputs carry the flasher relay's actual on/off
    // wave, so drawing the raw state IS the blink - no timer needed here.
    const SwitchData& s = g_data.sw;
    drawLeftTurnIcon  (im, 282, 120, s.blinkerL,   t);
    drawHeadlightsIcon(im, 322, 120, s.headlights, t);
    drawBrightsIcon   (im, 362, 120, s.brights,    t);
    drawRightTurnIcon (im, 402, 120, s.blinkerR,   t);
    }

// --- 6. the MODE_DEBUG dense layout -------------------------------------------------
// Twelve rows of raw numbers across the three panels - the serial debug
// print, readable without a laptop. Everything stays green (this mode is
// for reading values, not for judging them) except the top-alarm tag in
// the first page's corner, which wears its catalog color.

static void debugRow(tgx::Image<tgx::RGB565>& im, const Theme& t, int row, const char* text)
    {
    // 4 rows on a 142 px panel = 34 px pitch (the 30 px face plus breathing
    // room; descenders may kiss the next row - density is the point here).
    im.drawTextEx(text, {4, 2 + row * 34}, FONT_LABEL,
                  tgx::Anchor::TOPLEFT, false, false, t.green);
    }

void gaugeRenderDebug(uint16_t* fb, uint8_t page)
    {
    tgx::Image<tgx::RGB565> im(fb, SCREEN_LX, SCREEN_LY);
    const Theme t = buildTheme();
    im.fillScreen(t.bg);

    char line[40];
    const EcuData& e = g_data.ecu;

    switch (page)
        {
        default:
        case 0: // ECU page - plus the top-alarm tag in the corner
            snprintf(line, sizeof(line), "RPM %5u MAP%5.1f", e.rpm, e.mapKpa);
            debugRow(im, t, 0, line);
            snprintf(line, sizeof(line), "CLT %5.1f IAT%5.1f", e.cltC, e.matC);
            debugRow(im, t, 1, line);
            snprintf(line, sizeof(line), "OIL %4.1fP %5.1fC", e.oilPressPsi, e.oilTempC);
            debugRow(im, t, 2, line);
            snprintf(line, sizeof(line), "PW %5.2f DTY%5.1f%%", e.injPwMs, e.injDutyPct);
            debugRow(im, t, 3, line);

            if (g_data.alarms.top != ALARM_NONE)
                im.drawTextEx(alarmName(g_data.alarms.top), {SCREEN_LX - 4, 2},
                              FONT_LABEL, tgx::Anchor::TOPRIGHT, false, false,
                              alarmTint(t, alarmColor(g_data.alarms.top)));
            break;

        case 1: // mixture + electrical page
            snprintf(line, sizeof(line), "LAM %5.3f T%5.3f", e.lambda, e.lambdaTarget);
            debugRow(im, t, 0, line);
            // '*' = the mixture window is full and the AFR alarms are judging it
            snprintf(line, sizeof(line), "ERR%+6.3f%c TRM%+5.1f", e.lambdaErr2s,
                     e.lambdaJudgeable ? '*' : ' ', e.egoCorPct);
            debugRow(im, t, 1, line);
            snprintf(line, sizeof(line), "VLT %4.1f ADV %4.1f", e.battVolts, e.sparkAdvDeg);
            debugRow(im, t, 2, line);
            snprintf(line, sizeof(line), "ST x%02X CODE%5u", e.statusBits, e.lastError);
            debugRow(im, t, 3, line);
            break;

        case 2: // BMS + fuel + board page
            {
            const BmsData&  m = g_data.bms;
            const FuelData& f = g_data.fuel;
            snprintf(line, sizeof(line), "BMS%6.2fV%+6.1fA%3u%%", m.packVolts, m.packAmps, m.socPct);
            debugRow(im, t, 0, line);
            snprintf(line, sizeof(line), "CEL%6.3f-%5.3fV%3.0fC", m.minCellVolts,
                     m.maxCellVolts, m.maxCellTempC);
            debugRow(im, t, 1, line);
            snprintf(line, sizeof(line), "FUL S%3.0f%% C%3.0f%%%5.1fg", f.levelPct,
                     f.calcPct, f.calcGallons);
            debugRow(im, t, 2, line);
            const BoardData& b = g_data.board;
            snprintf(line, sizeof(line), "CPU %3.0fC  %02u:%02u:%02u", b.cpuTempC,
                     b.hh, b.mm, b.ss);
            debugRow(im, t, 3, line);
            break;
            }
        }
    }

// --- public entry point --------------------------------------------------------------

void gaugeRenderScreen(uint16_t* fb, ScreenContent content)
    {
    // Wrap the caller's raw buffer in a tgx canvas. The Image object is just
    // a view (pointer + dimensions) - constructing one costs nothing.
    tgx::Image<tgx::RGB565> im(fb, SCREEN_LX, SCREEN_LY);
    const Theme t = buildTheme();

    switch (content)
        {
        case SCREEN_OIL_VOLTS:  renderOilVolts (im, t); break;
        case SCREEN_CLT_FUEL:   renderCltFuel  (im, t); break;
        case SCREEN_PSI_LAMBDA: renderPsiLambda(im, t); break;
        default:                im.fillScreen(t.bg);    break;
        }
    }
